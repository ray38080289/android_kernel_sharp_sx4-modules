#include <dt-bindings/gpio/gpio.h>

/* SD card insert detect high active change */
&mmc1 {
	/delete-property/ cd-gpios;
	cd-gpios = <&pio 4 GPIO_ACTIVE_HIGH>;
};

/* DISPSYS GPIO standardization end */
&mt6360_regulator {
	sdcard-det-en = <1>;
	sdcard-hlact = <0>;
};
