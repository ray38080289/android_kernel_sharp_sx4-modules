## drivers/fih/Kconfig
```kconfig
#
# fih driver
#

menu "fih driver"

config FIH
	bool "fih"
	default n
	help
	  support fih

config FIH_SX3
	bool "fih_sx3"
	default n
	help
	  support fih_sx3

config FIH_SX4
	bool "fih_sx4"
	default n
	help
	  support fih_sx4

config FIH_APR
	tristate "fih_apr"
	depends on FIH
	default n
	help
	  support fih_apr

config FIH_BINF
	tristate "fih_binf"
	depends on FIH
	default n
	help
	  support fih_binf

config FIH_CPU
	tristate "fih_cpu"
	depends on FIH
	default n
	help
	  support fih_cpu

config FIH_DDR
	tristate "fih_ddr"
	depends on FIH
	default n
	help
	  support fih_ddr

config FIH_EXP
	tristate "fih_exp"
	depends on FIH
	default n
	help
	  support fih_exp

config FIH_FVER
	tristate "fih_fver"
	depends on FIH
	default n
	help
	  support fih_fver

config FIH_INFO
	tristate "fih_info"
	depends on FIH
	default n
	help
	  support fih_info

config FIH_MFD
	tristate "fih_mfd"
	depends on FIH
	default n
	help
	  support fih_mfd

config FIH_PDD
	tristate "fih_pdd"
	depends on FIH
	default n
	help
	  support fih_pdd

config FIH_SEB
	tristate "fih_seb"
	depends on FIH
	default n
	help
	  support fih_seb

config FIH_SIM
	tristate "fih_sim"
	depends on FIH
	default n
	help
	  support fih_sim

config FIH_TRAY
	tristate "fih_tray"
	depends on FIH
	default n
	help
	  support fih_tray

config FIH_UFS
	tristate "fih_ufs"
	depends on FIH
	default n
	help
	  support fih_ufs

config SHR_LOG
	tristate "shr_log"
	depends on FIH
	default n
	help
	  support shr_log

config FIH_TOUCH
	tristate "fih_touch"
	depends on FIH
	default n
	help
	  support fih_touch

endmenu
```

## drivers/input/Kconfig
```kconfig
# SPDX-License-Identifier: GPL-2.0-only
#
# Input device configuration
#

source "drivers/input/fingerprint/Kconfig"
```

## drivers/input/fingerprint/Kconfig
```kconfig
# SPDX-License-Identifier: GPL-2.0-only
#
# Fingerprint configuration
#
#
config MTK_FINGERPRINT_SUPPORT
	bool "Mediatek Fingerprint"
	default n
	help
	  Fingerprint mtk driver enable/disable
	  in the kernel.Say Y here if you want to
	  use mediatek fingerprint driver,fingerprint
	  driver will support fingerprint function

config FPC_FINGERPRINT_STANDALONE
	tristate "FPC SPI and IRQ Driver"
	default n
	help
	 This is a FPC chipset SPI and IRQ Driver.
```

## drivers/input/touchscreen/FT5446U/Kconfig
```kconfig
#
# Focaltech Touchscreen driver configuration
#

config TOUCHSCREEN_FT5446U
    tristate "Focaltech Touchscreen"
    default n
    help
      Say Y here if you have Focaltech touch panel.
      If unsure, say N.
      
config TOUCHSCREEN_FTS_DIRECTORY
    string "Focaltech ts directory name"
    default "FT5446U"
    depends on TOUCHSCREEN_FT5446U

config TOUCHSCREEN_FTS_GKI_MODULE_DRIVER
    tristate "Focaltech ts gki module driver"
    default n
    depends on TOUCHSCREEN_FT5446U
```

## drivers/input/touchscreen/NT36528/Kconfig
```kconfig
#
# Novatek NT36xxx touchscreen driver configuration
#
config TOUCHSCREEN_NT36528_HOSTDL_SPI
	tristate "Novatek NT36xxx host download SPI driver"
	default y
	help
	  Say Y here if you have a Novatek NT36xxx no flash touchscreen connected
	  to your system by SPI bus.

	  If unsure, say N.

config TOUCHSCREEN_NVT_GKI_RAWDATA_MODULE_DRIVER
	tristate "Novatek ts gki module driver"
	default n
	help
	  Say Y here if you have a Novatek NT36xxx no flash touchscreen connected
	  to your system by SPI bus.

	  If unsure, say N.
```

## drivers/input/touchscreen/sitronix_ts/Kconfig
```kconfig
#
# Sitronix Touchscreen driver configuration
#

config TOUCHSCREEN_SITRONIX_TS
    tristate "Sitronix Touchscreen"
    default n
    help
        Say Y here if you have Sitronix touch panel.
        If unsure, say N.

config TOUCHSCREEN_SITRONIX_TS_RAWDATA
    tristate "Sitronix ts directory name"
    default n
    depends on TOUCHSCREEN_SITRONIX_TS
```
